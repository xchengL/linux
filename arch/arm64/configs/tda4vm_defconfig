## lib/xcdbg/Kconfig
```kconfig
# SPDX-License-Identifier: GPL-2.0

config XC_DEBUG
    tristate "xc debug library"
    default n
    help
      This is xc debug library that provides some debug tips.
      Say Y here if you want to build it into the kernel.
      Say M if you want to build it as a module.
```
